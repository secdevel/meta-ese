## conf/layer.conf
```bitbake
# We have a conf and classes directory, add to BBPATH
BBPATH .= ":${LAYERDIR}"

# We have recipes-* directories, add to BBFILES
BBFILES += "${LAYERDIR}/recipes-*/*/*.bb \
            ${LAYERDIR}/recipes-*/*/*.bbappend"

BBFILE_COLLECTIONS += "meta-ese"
BBFILE_PATTERN_meta-ese = "^${LAYERDIR}/"
BBFILE_PRIORITY_meta-ese = "6"

LAYERDEPENDS_meta-ese = "core"
LAYERSERIES_COMPAT_meta-ese = "scarthgap"
```
